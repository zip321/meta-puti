## conf/layer.conf
```bitbake
# We have a conf and classes directory, add to BBPATH
BBPATH .= ":${LAYERDIR}"

# We have recipes-* directories, add to BBFILES
BBFILES += "${LAYERDIR}/recipes-*/*/*.bb \
            ${LAYERDIR}/recipes-*/*/*.bbappend"

BBFILE_COLLECTIONS += "puti"
BBFILE_PATTERN_puti = "^${LAYERDIR}/"
BBFILE_PRIORITY_puti = "99"

LAYERDEPENDS_puti = "egs"
LAYERSERIES_COMPAT_puti = "honister"
```

## conf/machine/intel-ast2600-puti.conf
```bitbake
COMPATIBLE_MACHINE:intel-ast2600-puti = "intel-ast2600-puti"
KMACHINE = "aspeed"

MACHINEOVERRIDES = "${MACHINE}"
# Add override "intel-ast2600" to include MACHINE "intel-ast2600"'s patches,
# and include recipes with 'COMPATIBLE_MACHINE = "intel-ast2600"'
# meta-ast2600/recipes-bsp/uboot
# meta-egs/recipes-bsp/uboot
# meta-ast2600/recipes-kernel/linux
MACHINEOVERRIDES:append:intel-ast2600-puti = ":intel-ast2600"

require conf/machine/include/ast2600.inc
require conf/machine/include/obmc-bsp-si-common.inc
require conf/machine/include/intel.inc

TARGET_FPU = "hard"

PREFERRED_PROVIDER_u-boot-fw-utils ?= "u-boot-fw-utils-aspeed-sdk"

UBOOT_MACHINE = "ast2600_openbmc_defconfig"
UBOOT_DEVICETREE = "ast2600-intel"

VIRTUAL-RUNTIME_skeleton_workbook = "${MACHINE}-config"

IMAGE_CLASSES += "${@bb.utils.contains('IMAGE_FSTYPES', 'intel-pfr', 'image_types_intel_pfr', '', d)}"

KERNEL_DEVICETREE = " \
    ${KMACHINE}-bmc-intel-ast2600-puti.dtb \
    "
```

## conf/machine/intel-ast2600.conf
```bitbake
require conf/machine/include/intel-ast2600.inc

KERNEL_DEVICETREE += " \
    ${KMACHINE}-bmc-${COMPATIBLE_MACHINE}-acm.dtb \
    "
```
